## Kconfig
```kconfig
config RT_FRAMEWORK
    bool "autosar cp support"
    default n
	---help---
		Enable the autosar os module


if RT_FRAMEWORK

config RT_FRAMEWORK_NCORES
	int "RT_FRAMEWORK_NCORES"
	default BMP_NCPUS
	---help---
		Enable RT_FRAMEWORK_NCORES

config RT_FRAMEWORK_EXTENDED_STATUS
	bool "RT_FRAMEWORK_EXTENDED_STATUS"
	default y
	---help---
		Enable RT_FRAMEWORK_EXTENDED_STATUS

config RT_FRAMEWORK_ACCESSCHECK
	bool "RT_FRAMEWORK_ACCESSCHECK"
	default y
	---help---
		Enable RT_FRAMEWORK_ACCESSCHECK

config RT_FRAMEWORK_TASK_MULTIPLE_ACTIVATION
	bool "RT_FRAMEWORK_TASK_MULTIPLE_ACTIVATION"
	default y
	---help---
		Enable RT_FRAMEWORK_TASK_MULTIPLE_ACTIVATION

config RT_FRAMEWORK_MULTIAPP
	bool "RT_FRAMEWORK_MULTIAPP"
	default n
	---help---
		Enable RT_FRAMEWORK_MULTIAPP

config RT_FRAMEWORK_COUNTER
	bool "RT_FRAMEWORK_COUNTER"
	default n
	---help---
		Enable RT_FRAMEWORK_COUNTER

config RT_FRAMEWORK_MEMPOOL
	bool "RT_FRAMEWORK_MEMPOOL"
	default n
	---help---
		Enable RT_FRAMEWORK_MEMPOOL

config RT_FRAMEWORK_IPICALL
	bool "RT_FRAMEWORK_IPICALL"
	default n
	---help---
		Enable RT_FRAMEWORK_IPICALL

config RT_FRAMEWORK_IPICALL_SYNC
	depends on RT_FRAMEWORK_IPICALL
	bool "RT_FRAMEWORK_IPICALL_SYNC"
	default y
	---help---
		Enable RT_FRAMEWORK_IPICALL_SYNC

config RT_FRAMEWORK_SPINLOCK
	bool "RT_FRAMEWORK_SPINLOCK"
	default n
	---help---
		Enable RT_FRAMEWORK_SPINLOCK

config RT_FRAMEWORK_RESOURCE
	bool "RT_FRAMEWORK_RESOURCE"
	default n
	---help---
		Enable RT_FRAMEWORK_RESOURCE

config RT_FRAMEWORK_TIMER
	bool "RT_FRAMEWORK_TIMER"
	default n
	---help---
		Enable RT_FRAMEWORK_TIMER

config RT_FRAMEWORK_SCHTBL
	bool "RT_FRAMEWORK_SCHTBL"
	default n
	---help---
		Enable RT_FRAMEWORK_SCHTBL

config RT_FRAMEWORK_HOOK
	bool "RT_FRAMEWORK_HOOK"
	default n
	---help---
		Enable RT_FRAMEWORK_HOOK

config RT_FRAMEWORK_SYSCALL
	bool "RT_FRAMEWORK_SYSCALL"
	default n
	---help---
		Enable RT_FRAMEWORK_SYSCALL

config RT_FRAMEWORK_ERROR
	bool "RT_FRAMEWORK_ERROR"
	default n
	---help---
		Enable RT_FRAMEWORK_ERROR

config RT_FRAMEWORK_MEMORY_PROTECTION
	depends on RT_FRAMEWORK_SYSCALL
	bool "RT_FRAMEWORK_MEMORY_PROTECTION"
	default n
	---help---
		Enable RT_FRAMEWORK_MEMORY_PROTECTION

config RT_FRAMEWORK_ISOLATE
	depends on RT_FRAMEWORK_MEMORY_PROTECTION
	bool "RT_FRAMEWORK_ISOLATE"
	default n
	---help---
		Enable RT_FRAMEWORK_ISOLATE

endif # RT_FRAMEWORK
```
