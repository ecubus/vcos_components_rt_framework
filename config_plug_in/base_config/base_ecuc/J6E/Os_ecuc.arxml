AUTOSAR XML (schema 00046)
package /ActiveEcuC
  module config Os: implementation-config-variant=VARIANT-PRE-COMPILE, module-description=Os_Impl
    OSDEFAULTAPPMODE (OsAppMode)
    OSAUTOSTARTMODE (OsAppMode)
    SystemApplication_Core0 (OsApplication):
      OsIsPrivileged = true
      OsAppMemoryProtectionIdentifier = (unset)
      OsAppCounterRef = /ActiveEcuC/Os/systemtimer0
      OsAppEcucPartitionRef = /ActiveEcuC/EcuC/EcucPartitionCollection/EcucPartition_0
      OsAppIsrRef = /ActiveEcuC/Os/core0_sc_isr
      OsApplicationCoreRef = /ActiveEcuC/EcuC/EcucHardware/EcucCoreDefinition0
      OsAppScheduleTableRef = (unset)
      OsAppTaskRef = /ActiveEcuC/Os/core0_shell
      OsAppIsrRef = /ActiveEcuC/Os/core0_ipicall_isr
      OsAppIsrRef = /ActiveEcuC/Os/core0_uart_isr
      OsAppIsrRef = /ActiveEcuC/Os/core0_systick_isr
    SystemApplication_Core1 (OsApplication):
      OsIsPrivileged = true
      OsAppMemoryProtectionIdentifier = (unset)
      OsAppCounterRef = /ActiveEcuC/Os/systemtimer1
      OsAppEcucPartitionRef = /ActiveEcuC/EcuC/EcucPartitionCollection/EcucPartition_1
      OsAppIsrRef = /ActiveEcuC/Os/core1_sc_isr
      OsApplicationCoreRef = /ActiveEcuC/EcuC/EcucHardware/EcucCoreDefinition1
      OsAppScheduleTableRef = (unset)
      OsAppTaskRef = /ActiveEcuC/Os/core1_shell
      OsAppIsrRef = /ActiveEcuC/Os/core1_ipicall_isr
      OsAppIsrRef = /ActiveEcuC/Os/core1_uart_isr
      OsAppIsrRef = /ActiveEcuC/Os/core1_systick_isr
    core0_shell (OsTask):
      OsTaskUsesFpu = true
      OsTaskActivation = 1
      OsTaskPriority = 10
      OsTaskStackSize = 4096
      OsTaskType = EXTENDED
      OsTaskSchedule = FULL
      OsTaskEventRef = (unset)
      OsTaskAccessingApplication = /ActiveEcuC/Os/SystemApplication_Core0
      OsTaskResourceRef = (unset)
      OsTaskAutostart: OsTaskAppModeRef=/ActiveEcuC/Os/OSAUTOSTARTMODE
    core1_shell (OsTask):
      OsTaskUsesFpu = true
      OsTaskActivation = 1
      OsTaskPriority = 10
      OsTaskStackSize = 4096
      OsTaskType = EXTENDED
      OsTaskSchedule = FULL
      OsTaskAccessingApplication = /ActiveEcuC/Os/SystemApplication_Core1
      OsTaskEventRef = (unset)
      OsTaskResourceRef = (unset)
      OsTaskAutostart: OsTaskAppModeRef=/ActiveEcuC/Os/OSAUTOSTARTMODE
    OsCore0 (OsCore): OsCoreBswApplicationRef=/ActiveEcuC/Os/SystemApplication_Core0
    OsCore1 (OsCore): OsCoreBswApplicationRef=/ActiveEcuC/Os/SystemApplication_Core1
    J6E (OsPublishedInformation): OsKernelVersion=1.0.0, OsPlatformName=CR52XX
      OsDerivativeInformation: OsStackAlignment=4
        GTM0 (OsHardWareTimer): OsHardWareTimerClockFrequency=40, OsHardWareTimerChannel=GTM0
        GTM1 (OsHardWareTimer): OsHardWareTimerClockFrequency=40, OsHardWareTimerChannel=GTM1
        OsPhysicalCore0 (OsPhysicalCore): OsPhysicalCoreId=0
        OsPhysicalCore1 (OsPhysicalCore): OsPhysicalCoreId=1
    8 x OsIsr, all with OsIsrCategory=CATEGORY_2:
      core0_systick_isr: OsIsrInitialEnableInterruptSource=false, OsIsrInterruptPriority=30, OsIsrInterruptSource=30, OsIsrEntryFunctionName=core0_systick_handler
      core0_uart_isr: OsIsrInitialEnableInterruptSource=true, OsIsrInterruptPriority=21, OsIsrInterruptSource=45, OsIsrEntryFunctionName=up_uart_rx_handler
      core0_ipicall_isr: OsIsrInitialEnableInterruptSource=true, OsIsrInterruptPriority=19, OsIsrInterruptSource=234, OsIsrEntryFunctionName=up_ipicall_isr_handler
      core0_sc_isr: OsIsrInitialEnableInterruptSource=true, OsIsrInterruptPriority=20, OsIsrInterruptSource=237, OsIsrEntryFunctionName=j6e_switchcore_isr_handler
      core1_systick_isr: OsIsrInitialEnableInterruptSource=false, OsIsrInterruptPriority=30, OsIsrInterruptSource=30, OsIsrEntryFunctionName=core1_systick_handler
      core1_uart_isr: OsIsrInitialEnableInterruptSource=false, OsIsrInterruptPriority=21, OsIsrInterruptSource=45, OsIsrEntryFunctionName=up_uart_rx_handler
      core1_ipicall_isr: OsIsrInitialEnableInterruptSource=true, OsIsrInterruptPriority=19, OsIsrInterruptSource=235, OsIsrEntryFunctionName=up_ipicall_isr_handler
      core1_sc_isr: OsIsrInitialEnableInterruptSource=true, OsIsrInterruptPriority=20, OsIsrInterruptSource=238, OsIsrEntryFunctionName=j6e_switchcore_isr_handler
    systemtimer0 (OsCounter):
      OsSecondsPerTick = 0.000000025
      OsCounterMaxAllowedValue = 1073741823
      OsCounterMinCycle = 1
      OsCounterTicksPerBase = (unset)
      OsCounterType = HARDWARE
      OsCounterAccessingApplication = /ActiveEcuC/Os/SystemApplication_Core0
      OsDriver: OsIsrRef=/ActiveEcuC/Os/core0_systick_isr, OsHardwareTimerChannelRef=/ActiveEcuC/Os/J6E/OsDerivativeInformation/GTM0
    systemtimer1 (OsCounter):
      OsSecondsPerTick = 0.000000025
      OsCounterMaxAllowedValue = 1073741823
      OsCounterMinCycle = 1
      OsCounterTicksPerBase = (unset)
      OsCounterType = HARDWARE
      OsCounterAccessingApplication = /ActiveEcuC/Os/SystemApplication_Core1
      OsDriver: OsIsrRef=/ActiveEcuC/Os/core1_systick_isr, OsHardwareTimerChannelRef=/ActiveEcuC/Os/J6E/OsDerivativeInformation/GTM1
