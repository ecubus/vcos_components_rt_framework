AUTOSAR XML (schema 00046)
package /ActiveEcuC
  module config Os: implementation-config-variant=VARIANT-PRE-COMPILE, module-description=Os_Impl
    OSDEFAULTAPPMODE (OsAppMode)
    OSAUTOSTARTMODE (OsAppMode)
    4 x OsApplication, all with OsIsPrivileged=true, OsAppMemoryProtectionIdentifier=(unset), OsAppCounterRef=(unset), OsAppIsrRef=(unset), OsAppScheduleTableRef=(unset):
      SystemApplication_Core{0..3}: OsAppEcucPartitionRef=/ActiveEcuC/EcuC/EcucPartitionCollection/EcucPartition_{0..3}, OsApplicationCoreRef=/ActiveEcuC/EcuC/EcucHardware/EcucCoreDefinition{0..3}, OsAppTaskRef=/ActiveEcuC/Os/core{0..3}_shell
    4 x OsTask, all with OsTaskUsesFpu=true, OsTaskActivation=1, OsTaskStackSize=4096, OsTaskType=EXTENDED, OsTaskSchedule=FULL, OsTaskEventRef=(unset), OsTaskResourceRef=(unset):
      core0_shell: OsTaskPriority=10, OsTaskAccessingApplication=/ActiveEcuC/Os/SystemApplication_Core0
        OsTaskAutostart: OsTaskAppModeRef=/ActiveEcuC/Os/OSAUTOSTARTMODE
      core1_shell: OsTaskPriority=10, OsTaskAccessingApplication=/ActiveEcuC/Os/SystemApplication_Core1
        OsTaskAutostart: OsTaskAppModeRef=/ActiveEcuC/Os/OSAUTOSTARTMODE
      core2_shell: OsTaskPriority=5, OsTaskAccessingApplication=/ActiveEcuC/Os/SystemApplication_Core2
        OsTaskAutostart: OsTaskAppModeRef=/ActiveEcuC/Os/OSAUTOSTARTMODE
      core3_shell: OsTaskPriority=5, OsTaskAccessingApplication=/ActiveEcuC/Os/SystemApplication_Core3
        OsTaskAutostart: OsTaskAppModeRef=/ActiveEcuC/Os/OSAUTOSTARTMODE
    4 x OsCore:
      OsCore{0..3}: OsCoreBswApplicationRef=/ActiveEcuC/Os/SystemApplication_Core{0..3}
