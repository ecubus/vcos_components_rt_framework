AUTOSAR XML (schema 00046)
package /ActiveEcuC
  module config Os: implementation-config-variant=VARIANT-PRE-COMPILE, module-description=Os_Impl
    OSDEFAULTAPPMODE (OsAppMode)
    OSAUTOSTARTMODE (OsAppMode)
    4 x OsApplication, all with OsTrusted=true, OsIsPrivileged=true, OsTrustedApplicationDelayTimingViolationCall=true, OsTrustedApplicationWithProtection=false, OsAppAlarmRef=, OsAppCounterRef=, OsAppEcucPartitionRef=/ActiveEcuC/EcuC/EcucPartitionCollection/EcucPartition, OsAppIsrRef=, OsApplicationCoreRef=, OsAppScheduleTableRef=, OsRestartTask=<empty>:
      SystemApplication_Core{0..3}: OsAppTaskRef=/ActiveEcuC/Os/Os_System_Idle_Core{0..3}, OsAppTaskRef=/ActiveEcuC/Os/Os_System_Shell_Core{0..3}
    8 x OsTask, all with OsTaskWithProtection=false, OsTaskUsesFpu=true, OsTaskActivation=1, OsTaskTicksToWait=4294967295, OsTaskSchedule=FULL, OsMemoryMappingCodeLocationRef=<empty>, OsTaskEventRef=, OsTaskResourceRef=:
      Os_System_Idle_Core0: OsTaskPriority=0, OsTaskStackSize=2048, OsTaskType=BASIC, OsTaskAccessingApplication=/ActiveEcuC/Os/SystemApplication_Core0
        OsTaskAutostart: OsTaskAppModeRef=/ActiveEcuC/Os/OSAUTOSTARTMODE
      Os_System_Idle_Core1: OsTaskPriority=0, OsTaskStackSize=2048, OsTaskType=BASIC, OsTaskAccessingApplication=/ActiveEcuC/Os/SystemApplication_Core1
        OsTaskAutostart: OsTaskAppModeRef=/ActiveEcuC/Os/OSAUTOSTARTMODE
      Os_System_Idle_Core2: OsTaskPriority=0, OsTaskStackSize=2048, OsTaskType=BASIC, OsTaskAccessingApplication=/ActiveEcuC/Os/SystemApplication_Core2
        OsTaskAutostart: OsTaskAppModeRef=/ActiveEcuC/Os/OSAUTOSTARTMODE
      Os_System_Idle_Core3: OsTaskPriority=0, OsTaskStackSize=2048, OsTaskType=BASIC, OsTaskAccessingApplication=/ActiveEcuC/Os/SystemApplication_Core3
        OsTaskAutostart: OsTaskAppModeRef=/ActiveEcuC/Os/OSAUTOSTARTMODE
      Os_System_Shell_Core0: OsTaskPriority=5, OsTaskStackSize=8192, OsTaskType=EXTENDED, OsTaskAccessingApplication=/ActiveEcuC/Os/SystemApplication_Core0
        OsTaskAutostart: OsTaskAppModeRef=/ActiveEcuC/Os/OSAUTOSTARTMODE
      Os_System_Shell_Core1: OsTaskPriority=5, OsTaskStackSize=8192, OsTaskType=EXTENDED, OsTaskAccessingApplication=/ActiveEcuC/Os/SystemApplication_Core1
        OsTaskAutostart: OsTaskAppModeRef=/ActiveEcuC/Os/OSAUTOSTARTMODE
      Os_System_Shell_Core2: OsTaskPriority=5, OsTaskStackSize=8192, OsTaskType=EXTENDED, OsTaskAccessingApplication=/ActiveEcuC/Os/SystemApplication_Core2
        OsTaskAutostart: OsTaskAppModeRef=/ActiveEcuC/Os/OSAUTOSTARTMODE
      Os_System_Shell_Core3: OsTaskPriority=5, OsTaskStackSize=8192, OsTaskType=EXTENDED, OsTaskAccessingApplication=/ActiveEcuC/Os/SystemApplication_Core3
        OsTaskAutostart: OsTaskAppModeRef=/ActiveEcuC/Os/OSAUTOSTARTMODE
